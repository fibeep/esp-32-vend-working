## vending-esp32-display/main/Kconfig.projbuild
```kconfig
menu "MDB Cashless Device"

    choice
        prompt "Peripheral Addresses"
        default CASHLESS_ADDR_1

        config CASHLESS_ADDR_1
            bool "Cashless Device #1"

        config CASHLESS_ADDR_2
            bool "Cashless Device #2"

    endchoice

    config CASHLESS_DEVICE_ADDRESS
        int
        default 16 if CASHLESS_ADDR_1
        default 96 if CASHLESS_ADDR_2

    choice
        prompt "Country / Currency Code"
        default CURRENCY_UNKNOWN

        config CURRENCY_EUR
            bool "EUR - 0x0978"

        config CURRENCY_USD
            bool "USD - 0x0840"

        config CURRENCY_BRL
            bool "BRL - 0x0986"

        config CURRENCY_UNKNOWN
            bool "UNKNOWN - 0xffff"
    endchoice

    config MDB_CURRENCY_CODE
        int
        default 6520 if CURRENCY_EUR
        default 6208 if CURRENCY_USD
        default 6534 if CURRENCY_BRL
        default 65535 if CURRENCY_UNKNOWN

    choice
        prompt "Scale Factor (MDB)"
        default SCALE_FACTOR_1

        config SCALE_FACTOR_1
            bool "1"

        config SCALE_FACTOR_10
            bool "10"

        config SCALE_FACTOR_100
            bool "100"

    endchoice

    config MDB_SCALE_FACTOR
        int
        default 1 if SCALE_FACTOR_1
        default 10 if SCALE_FACTOR_10
        default 100 if SCALE_FACTOR_100

    config MDB_DECIMAL_PLACES
        int "Decimal Places (MDB)"
        default 2
        range 0 3

endmenu # MDB Cashless Device

menu "MQTT Broker Configuration"

    config MQTT_BROKER_URI
        string "Default MQTT Broker URI"
        default "mqtt://mqtt.panamavendingmachines.com"
        help
            Default MQTT broker URI used when no NVS override is present.
            Can be overridden at runtime via BLE command 0x08 or the Web UI.
            Examples: "mqtt://mqtt.panamavendingmachines.com", "mqtt://192.168.1.100:1883"

    config MQTT_USERNAME
        string "Default MQTT Username"
        default "vmflow"
        help
            Default MQTT broker username.  Can be overridden at runtime
            via BLE command 0x09.

    config MQTT_PASSWORD
        string "Default MQTT Password"
        default "vmflow"
        help
            Default MQTT broker password.  Can be overridden at runtime
            via BLE command 0x09.

endmenu # MQTT Broker Configuration

menu "Yappy Payment Configuration"

    config YAPPY_KIOSK_MODE
        bool "Enable Yappy Kiosk Mode (auto-session)"
        default y
        help
            When enabled, the machine operates as a self-service kiosk:
            - Auto-pushes unlimited funds on READER_ENABLE (always in session)
            - Auto-restarts session on SESSION_COMPLETE
            - VEND_REQUEST triggers Yappy QR generation on the dashboard
            - MDB session timer is kept alive during Yappy payment polling

    config YAPPY_BASE_URL
        string "Yappy API Base URL"
        default "https://api-checkout.yappy.cloud/v1"
        help
            Base URL for the Yappy payment API.
            Can be overridden at runtime via NVS key "yappy_base_url"
            in the "yappy" namespace.

    config YAPPY_API_KEY
        string "Yappy API Key"
        default "85f0e569-3648-4bab-9043-c925450cecea"
        help
            API key for Yappy payment gateway authentication.
            Can be overridden at runtime via NVS key "yappy_api_key"
            in the "yappy" namespace.

    config YAPPY_SECRET_KEY
        string "Yappy Secret Key"
        default "WVBfRkZGOEQ2QkUtQ0REOC0zRDdBLTk3Q0QtQTI2MjlCRDk1NEJD"
        help
            Secret key for Yappy payment gateway authentication.
            Can be overridden at runtime via NVS key "yappy_secret_key"
            in the "yappy" namespace.

    config YAPPY_ID_DEVICE
        string "Yappy Device ID"
        default "prba-01"
        help
            Device identifier registered with Yappy.
            Can be overridden at runtime via NVS key "yappy_id_device"
            in the "yappy" namespace.

    config YAPPY_NAME_DEVICE
        string "Yappy Device Name"
        default "Nombre de caja"
        help
            Human-readable name for this vending machine in Yappy.
            Can be overridden at runtime via NVS key "yappy_name_device"
            in the "yappy" namespace.

    config YAPPY_USER_DEVICE
        string "Yappy Device User"
        default "codigo-cajero"
        help
            User account associated with this device in Yappy.
            Can be overridden at runtime via NVS key "yappy_user_device"
            in the "yappy" namespace.

    config YAPPY_ID_GROUP
        string "Yappy Group ID"
        default "prueba"
        help
            Group identifier for this device in Yappy.
            Can be overridden at runtime via NVS key "yappy_id_group"
            in the "yappy" namespace.

endmenu # Yappy Payment Configuration

menu "Supabase Edge Function Configuration"

    config SUPABASE_URL
        string "Supabase Project URL"
        default "https://luntgcliwnyvrmrqpdts.supabase.co"
        help
            Your Supabase project URL. Used by the ESP32 to call
            the yappy-payment Edge Function.

    config SUPABASE_ANON_KEY
        string "Supabase Anon Key"
        default "eyJhbGciOiJIUzI1NiIsInR5cCI6IkpXVCJ9.eyJpc3MiOiJzdXBhYmFzZSIsInJlZiI6Imx1bnRnY2xpd255dnJtcnFwZHRzIiwicm9sZSI6ImFub24iLCJpYXQiOjE3NzMxMDA2MzEsImV4cCI6MjA4ODY3NjYzMX0.s5mBlh0YTXi2xhfd1vOX_R9Aof6S6D5ZXc8zK_G7074"
        help
            Supabase anonymous (publishable) key. Sent as the
            'apikey' header when calling Edge Functions.

    config ESP32_DEVICE_KEY
        string "ESP32 Device Key"
        default "vmf-esp32-yappy-2024-d7f3a9b2"
        help
            Shared secret between the ESP32 and the yappy-payment
            Edge Function. Sent as the 'x-device-key' header to
            authenticate ESP32 requests without a Supabase JWT.

    config VMFLOW_DEFAULT_SUBDOMAIN
        string "Default device subdomain (fallback if NVS empty)"
        default "3"
        help
            Numeric subdomain assigned to this device in the embedded table.
            Used as fallback when NVS has no provisioning data (no BLE setup).
            Set this to match the device's subdomain in Supabase.

    config VMFLOW_DEFAULT_PASSKEY
        string "Default device passkey (fallback if NVS empty)"
        default "c351905e9867c6126c"
        help
            18-character XOR encryption key matching this device's passkey
            in the Supabase embedded table.  Used as fallback when NVS has
            no provisioning data.

endmenu # Supabase Edge Function Configuration
```

## vending-esp32-display/sdkconfig.defaults
```kconfig
# ------------------------------------------------------------------
# sdkconfig.defaults - Default SDK configuration for vending-esp32
# ------------------------------------------------------------------
# These values are applied when building without an existing sdkconfig.
# Run `idf.py menuconfig` to customize further.
# ------------------------------------------------------------------

# Target: ESP32-S3
CONFIG_IDF_TARGET="esp32s3"

# Flash size: 16MB (ESP32-S3-N16R8)
CONFIG_ESPTOOLPY_FLASHSIZE_16MB=y

# Partition table: custom (3MB per OTA slot for LVGL binary)
CONFIG_PARTITION_TABLE_CUSTOM=y
CONFIG_PARTITION_TABLE_CUSTOM_FILENAME="partitions.csv"

# ------------------------------------------------------------------
# Bluetooth: DISABLED to free internal RAM for display + WiFi
# ------------------------------------------------------------------
# CONFIG_BT_ENABLED=y

# MQTT
CONFIG_MQTT_PROTOCOL_311=y
CONFIG_MQTT_TRANSPORT_SSL=y
CONFIG_MQTT_TRANSPORT_WEBSOCKET=y
CONFIG_MQTT_TRANSPORT_WEBSOCKET_SECURE=y

# MDB Cashless Device defaults
CONFIG_CASHLESS_ADDR_1=y
CONFIG_CASHLESS_DEVICE_ADDRESS=16
CONFIG_MDB_SCALE_FACTOR=1
CONFIG_MDB_DECIMAL_PLACES=2

# MQTT Broker defaults
CONFIG_MQTT_BROKER_URI="mqtt://mqtt.panamavendingmachines.com"
CONFIG_MQTT_USERNAME="vmflow"
CONFIG_MQTT_PASSWORD="vmflow"

# ------------------------------------------------------------------
# PSRAM — disabled (this board has no external PSRAM)
# ------------------------------------------------------------------
# CONFIG_SPIRAM=y

# ------------------------------------------------------------------
# LVGL Graphics Library
# ------------------------------------------------------------------
CONFIG_LV_COLOR_DEPTH_16=y
CONFIG_LV_DEF_REFR_PERIOD=33
CONFIG_LV_USE_QRCODE=y
CONFIG_LV_FONT_MONTSERRAT_14=y
CONFIG_LV_FONT_MONTSERRAT_20=y
CONFIG_LV_FONT_MONTSERRAT_28=y
CONFIG_LV_FONT_MONTSERRAT_36=y
CONFIG_LV_FONT_MONTSERRAT_48=y

# SPI master for display
CONFIG_SPI_MASTER_ISR_IN_IRAM=y
```

## vending-esp32/main/Kconfig.projbuild
```kconfig
menu "MDB Cashless Device"

    choice
        prompt "Peripheral Addresses"
        default CASHLESS_ADDR_1

        config CASHLESS_ADDR_1
            bool "Cashless Device #1"

        config CASHLESS_ADDR_2
            bool "Cashless Device #2"

    endchoice

    config CASHLESS_DEVICE_ADDRESS
        int
        default 16 if CASHLESS_ADDR_1
        default 96 if CASHLESS_ADDR_2

    choice
        prompt "Country / Currency Code"
        default CURRENCY_UNKNOWN

        config CURRENCY_EUR
            bool "EUR - 0x0978"

        config CURRENCY_USD
            bool "USD - 0x0840"

        config CURRENCY_BRL
            bool "BRL - 0x0986"

        config CURRENCY_UNKNOWN
            bool "UNKNOWN - 0xffff"
    endchoice

    config MDB_CURRENCY_CODE
        int
        default 6520 if CURRENCY_EUR
        default 6208 if CURRENCY_USD
        default 6534 if CURRENCY_BRL
        default 65535 if CURRENCY_UNKNOWN

    choice
        prompt "Scale Factor (MDB)"
        default SCALE_FACTOR_1

        config SCALE_FACTOR_1
            bool "1"

        config SCALE_FACTOR_10
            bool "10"

        config SCALE_FACTOR_100
            bool "100"

    endchoice

    config MDB_SCALE_FACTOR
        int
        default 1 if SCALE_FACTOR_1
        default 10 if SCALE_FACTOR_10
        default 100 if SCALE_FACTOR_100

    config MDB_DECIMAL_PLACES
        int "Decimal Places (MDB)"
        default 2
        range 0 3

endmenu # MDB Cashless Device

menu "MQTT Broker Configuration"

    config MQTT_BROKER_URI
        string "Default MQTT Broker URI"
        default "mqtt://mqtt.panamavendingmachines.com"
        help
            Default MQTT broker URI used when no NVS override is present.
            Can be overridden at runtime via BLE command 0x08 or the Web UI.
            Examples: "mqtt://mqtt.panamavendingmachines.com", "mqtt://192.168.1.100:1883"

    config MQTT_USERNAME
        string "Default MQTT Username"
        default "vmflow"
        help
            Default MQTT broker username.  Can be overridden at runtime
            via BLE command 0x09.

    config MQTT_PASSWORD
        string "Default MQTT Password"
        default "vmflow"
        help
            Default MQTT broker password.  Can be overridden at runtime
            via BLE command 0x09.

endmenu # MQTT Broker Configuration
```

## vending-esp32/sdkconfig.defaults
```kconfig
# ------------------------------------------------------------------
# sdkconfig.defaults - Default SDK configuration for vending-esp32
# ------------------------------------------------------------------
# These values are applied when building without an existing sdkconfig.
# Run `idf.py menuconfig` to customize further.
# ------------------------------------------------------------------

# Target: ESP32-S3
CONFIG_IDF_TARGET="esp32s3"

# Partition table: two OTA (large) for future OTA updates
CONFIG_PARTITION_TABLE_TWO_OTA_LARGE=y

# Bluetooth: NimBLE stack (lightweight BLE-only stack)
CONFIG_BT_ENABLED=y
CONFIG_BT_NIMBLE_ENABLED=y

# NimBLE roles (all needed for GATT server + PAX scanning)
CONFIG_BT_NIMBLE_ROLE_CENTRAL=y
CONFIG_BT_NIMBLE_ROLE_PERIPHERAL=y
CONFIG_BT_NIMBLE_ROLE_BROADCASTER=y
CONFIG_BT_NIMBLE_ROLE_OBSERVER=y
CONFIG_BT_NIMBLE_GATT_CLIENT=y
CONFIG_BT_NIMBLE_GATT_SERVER=y
CONFIG_BT_NIMBLE_SECURITY_ENABLE=y
CONFIG_BT_NIMBLE_SM_LEGACY=y
CONFIG_BT_NIMBLE_SM_SC=y

# NimBLE connection and buffer settings
CONFIG_BT_NIMBLE_MAX_CONNECTIONS=3
CONFIG_BT_NIMBLE_ATT_PREFERRED_MTU=256
CONFIG_BT_NIMBLE_PINNED_TO_CORE_0=y
CONFIG_BT_NIMBLE_HOST_TASK_STACK_SIZE=4096
CONFIG_BT_NIMBLE_EXT_SCAN=y
CONFIG_BT_NIMBLE_ENABLE_PERIODIC_SYNC=y

# BLE scanning support (for PAX counter)
CONFIG_BT_CTRL_BLE_SCAN=y
CONFIG_BT_CTRL_BLE_MASTER=y
CONFIG_BT_CTRL_BLE_ADV_REPORT_FLOW_CTRL_SUPP=y
CONFIG_BT_CTRL_BLE_SCAN_DUPL=y
CONFIG_BT_CTRL_SCAN_DUPL_TYPE_DEVICE=y

# BLE TX power
CONFIG_BT_CTRL_DFT_TX_POWER_LEVEL_P9=y

# MQTT
CONFIG_MQTT_PROTOCOL_311=y
CONFIG_MQTT_TRANSPORT_SSL=y
CONFIG_MQTT_TRANSPORT_WEBSOCKET=y
CONFIG_MQTT_TRANSPORT_WEBSOCKET_SECURE=y

# MDB Cashless Device defaults
CONFIG_CASHLESS_ADDR_1=y
CONFIG_CASHLESS_DEVICE_ADDRESS=16
CONFIG_MDB_SCALE_FACTOR=1
CONFIG_MDB_DECIMAL_PLACES=2

# MQTT Broker defaults
CONFIG_MQTT_BROKER_URI="mqtt://mqtt.panamavendingmachines.com"
CONFIG_MQTT_USERNAME="vmflow"
CONFIG_MQTT_PASSWORD="vmflow"
```
